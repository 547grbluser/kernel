## drivers/media/video/samsung/fimc/Kconfig
```kconfig
config VIDEO_FIMC
	bool "Samsung Camera Interface (FIMC) driver"
	depends on VIDEO_SAMSUNG && ARCH_S5PV210
	select VIDEO_IPC if ARCH_S5PV210
	default n
	help
	  This is a video4linux driver for Samsung FIMC device.

config VIDEO_IPC
	bool

config VIDEO_FIMC_DEBUG
	bool "FIMC driver debug messages"
	depends on VIDEO_FIMC

config VIDEO_FIMC_MIPI
	bool "MIPI-CSI2 Slave Interface support"
	depends on VIDEO_FIMC && ARCH_S5PV210
	default y
	
choice
depends on VIDEO_FIMC
prompt "Select Camera"
default CAMERA_OV3640
config CAMERA_OV3640
        bool "camera ov3640"
        depends on VIDEO_FIMC
        help
          camera ov3640 for real210

config CAMERA_TVP5150
        bool "camera tvp5150"
        depends on VIDEO_FIMC
        help
          camera tvp5150 for real210

endchoice

choice
depends on VIDEO_FIMC
prompt "Select Output Mode"
default VIDEO_FIMC_DMA_AUTO
config VIDEO_FIMC_DMA_AUTO
        bool "DMA AUTO MODE"
        depends on VIDEO_FIMC
        help
          This enables support for FIMC1 DMA AUTO mode

config VIDEO_FIMC_FIFO
        bool "FIFO MODE"
        depends on VIDEO_FIMC
        help
          This enables support for FIMC1 FIFO mode

endchoice
```
